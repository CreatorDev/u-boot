## board/imgtec/pistachio_bub/Kconfig
```kconfig
if TARGET_PISTACHIO_BUB

config SYS_BOARD
	default "pistachio_bub"

config SYS_VENDOR
	default "imgtec"

config SYS_CONFIG_NAME
	default "pistachio_bub"

endif

if TARGET_PISTACHIO_MARDUK

config SYS_BOARD
	default "pistachio_bub"

config SYS_VENDOR
	default "imgtec"

config SYS_CONFIG_NAME
	default "pistachio_marduk"

endif

if TARGET_PISTACHIO_BEETLE

config SYS_BOARD
	default "pistachio_bub"

config SYS_VENDOR
	default "imgtec"

config SYS_CONFIG_NAME
	default "pistachio_beetle"

endif

if TARGET_PISTACHIO_CONCERTO

config SYS_BOARD
	default "pistachio_bub"

config SYS_VENDOR
	default "imgtec"

config SYS_CONFIG_NAME
	default "pistachio_concerto"

endif
```

## configs/pistachio_concerto_defconfig
```kconfig
CONFIG_MIPS=y
CONFIG_NETDEVICES=y
CONFIG_DM_ETH=y
CONFIG_CMD_NET=y
CONFIG_TARGET_PISTACHIO_CONCERTO=y
CONFIG_MIPS_BOOT_FDT=y
CONFIG_DEFAULT_DEVICE_TREE="pistachio_concerto_mbub"
CONFIG_SPL=y
CONFIG_CMD_USB=y
CONFIG_OF_CONTROL=y
CONFIG_USB=y
CONFIG_USB_STORAGE=y
CONFIG_LIB_RAND=y
```

## drivers/mtd/Kconfig
```kconfig
source "drivers/mtd/nand/Kconfig"

source "drivers/mtd/spi/Kconfig"

source "drivers/mtd/spi-nand/Kconfig"
```

## drivers/mtd/spi-nand/Kconfig
```kconfig
menu "SPI NAND Device Support"

config MTD_SPI_NAND
	bool "SPI NAND device support"
	help
	  This is the framework for the SPI NAND.

config MTD_SPI_NAND_DEVICES
	bool "Support for SPI NAND devices (MT29F, GD5F)"
	depends on MTD_SPI_NAND
	help
	  Select this option if you require support for the most common SPI NAND
	  devices such as mt29f and gd5f.

endmenu
```
